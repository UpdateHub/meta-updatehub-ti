## conf/layer.conf
```bitbake
# We have a conf and classes directory, add to BBPATH
BBPATH .= ":${LAYERDIR}"

# We have recipes-* directories, add to BBFILES
BBFILES += " \
    ${LAYERDIR}/recipes-*/*/*.bb \
    ${LAYERDIR}/recipes-*/*/*.bbappend \
"

BBFILE_COLLECTIONS += "updatehub-ti"
BBFILE_PATTERN_updatehub-ti = "^${LAYERDIR}/"
BBFILE_PRIORITY_updatehub-ti = "6"

LAYERSERIES_COMPAT_updatehub-ti = "skyhead"
LAYERDEPENDS_updatehub-ti = "updatehub"


###
# Global setting to use UpadateHub with meta-ti layer
#
# Setting to use wic image
IMAGE_BOOT_FILES:updatehub-ti ??= ""
WKS_FILE_DEPENDS:updatehub-ti ??= "dosfstools-native mtools-native parted-native virtual/bootloader u-boot-updatehub-script"
WKS_FILES:updatehub-ti ??= "updatehub.ti.wks"
IMAGE_FSTYPES:updatehub-ti ??= "tar.xz wic.gz wic.bmap"
WKS_SEARCH_PATH:updatehub-ti ??= "${THISDIR}:${@':'.join('%s/wic' % p for p in '${BBPATH}'.split(':'))}:${@':'.join('%s/scripts/lib/wic/canned-wks' % l for l in '${BBPATH}:${COREBASE}'.split(':'))}"

# UpdateHub settings
UPDATEHUB_ACTIVE_INACTIVE_BACKEND:updatehub-ti ??= "u-boot"
UPDATEHUB_DEVICE_IDENTITY:updatehub-ti ??= "primary-iface"
UPDATEHUB_FILESYSTEM_SUPPORT:updatehub-ti ??= "ext4"
UPDATEHUB_IMAGE_TYPE:updatehub-ti ??= "active/inactive"
UPDATEHUB_INSTALL_MODE:updatehub-ti ??= "tarball"

PREFERRED_PROVIDER_u-boot-fw-utils:updatehub-ti ??= "u-boot-updatehub-fw-utils"
PREFERRED_PROVIDER_u-boot:updatehub-ti ??= "u-boot-updatehub"
PREFERRED_PROVIDER_u-boot-default-script:updatehub-ti ??= "u-boot-updatehub-script"
MACHINE_ESSENTIAL_EXTRA_RDEPENDS:updatehub-ti += " \
    kernel-image \
    kernel-devicetree \
"

# Do not change fstab file
WIC_CREATE_EXTRA_ARGS:updatehub-ti ??= "--no-fstab-update"

# UpdateHub Bootscript variables for Texas Instruments machines
UPDATEHUB_BOOTSCRIPT_LOAD_A:updatehub-ti ??= "\
load mmc \${mmcdev}:2 \${loadaddr} /boot/\${bootfile}; \
run findfdt; \
load mmc \${mmcdev}:2 \${fdtaddr} /boot/\${fdtfile} \
"
UPDATEHUB_BOOTSCRIPT_LOAD_B:updatehub-ti ??= "\
load mmc \${mmcdev}:3 \${loadaddr} /boot/\${bootfile}; \
run findfdt; \
load mmc \${mmcdev}:3 \${fdtaddr} /boot/\${fdtfile} \
"
UPDATEHUB_BOOTSCRIPT_FIND_ROOT_A:updatehub-ti ??= "part uuid mmc \${mmcdev}:2 uuid"
UPDATEHUB_BOOTSCRIPT_FIND_ROOT_B:updatehub-ti ??= "part uuid mmc \${mmcdev}:3 uuid"
UPDATEHUB_BOOTSCRIPT_BOOTARGS:updatehub-ti ??= "\
console=\${console} root=PARTUUID=\${uuid} \
rootfstype=ext4 rootwait rw "
UPDATEHUB_BOOTSCRIPT_BOOTCMD:updatehub-ti ??= "\
bootz \${loadaddr} - \${fdtaddr}"

###
# Configuration for BeagleBone machine
#
# UpdateHub settings for beaglebone machine
MACHINEOVERRIDES:prepend:beaglebone = "updatehub-ti:"
SPL_BINARY:updatehub-ti:beaglebone ??= "MLO"
UBOOT_SUFFIX:updatehub-ti:beaglebone ??= "img"
IMAGE_BOOT_FILES:updatehub-ti:beaglebone ??= "MLO u-boot.img boot.scr"
WKS_FILES:updatehub-ti:beaglebone ??= "updatehub.ti.wks"
```
